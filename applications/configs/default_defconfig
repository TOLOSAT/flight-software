## applications/gen/Kconfig
```kconfig
# Copyright (c) TOLOSAT 2026
# SPDX-License-Identifier: Apache-2.0

mainmenu "TOLOSAT Applications Configuration"

config CONFIG_NAME
    string "Configuration Name"
    default "default"
    help
        The name of the configuration used when saving or loading configs.

source "gen/Kconfig.options"
```

## bootloader/gen/Kconfig
```kconfig
mainmenu "TAPAS Flight Software Configuration"

menu "General setup"

config CONFIG_NAME
    string "Configuration Name"
    default "default"
    help
        The name of the configuration that will be used when saving or loading configs.

config PROJ_NAME
    string "Project Name"
    default "boot-software"
    help
        Enter the project name for the boot software.

endmenu

menu "Build Configuration"

choice
    prompt "Build Type Selection"
    default BUILD_DEBUG
    help
        Choose the build type for the project.

config BUILD_DEBUG
    bool "debug"
config BUILD_RELEASE
    bool "release"

endchoice

endmenu

menu "Target Option"

choice
    prompt "Target Board"
    default BOARD_ART_PI
    help
        Select the target board for the build.

config BOARD_ART_PI
    bool "ART PI"

endchoice

if BOARD_ART_PI
source "../bsp/ART_PI-BSP/Kconfig"
endif

config FPU
    bool "Enable FPU"
    depends on HAS_FPU
    default y
    help
      Enables support for the Floating Point Unit (FPU) if available.

endmenu

menu "System Configuration"

choice
    prompt "File System Mode"
    default FS_NONE
    help
        Select the file system mode.

config FS_SPISD
    bool "SPISD"
    depends on HAS_SPISD_DISK
config FS_SD
    bool "SD"
    depends on HAS_SD_DISK

endchoice

config USB_OTG
    bool "USB OTG"
    depends on HAS_USB_OTG

endmenu
```

## bsp/ART_PI-BSP/Kconfig
```kconfig
config BOARD_NAME
    string
    default "ART_PI"

config CHIP_VENDOR
    string
    default "ST"

config CHIP_FAMILLY
    string
    default "STM32H7"

config CHIP
    string
    default "STM32H750xx"

config ARCH
    string
    default "cortex-m7"

config DUAL_CORE
    bool
    default n

config HAS_LOAD_MEMORY_RAM
    bool
    default y

config HAS_LOAD_MEMORY_FLASH
    bool
    default n

config HAS_FPU
    bool
    default y

config FPU_TYPE
    string
    default "fpv5-d16"

config HAS_CACHE
    bool
    default y

config HAS_MPU
    bool
    default y

config HAS_ECC
    bool
    default y

config HAS_FS_SPISD
    bool
    default y

config HAS_FS_SD
    bool
    default y

config HAS_FS_RAM
    bool
    default n

config HAS_INVERTED_SYSLED_LOGIC
    bool
    default y
```

## bsp/DISCOVERY_F407VG-BSP/Kconfig
```kconfig
config BOARD_NAME
    string
    default "DISCOVERY_F407VG"

config CHIP_VENDOR
    string
    default "ST"

config CHIP_FAMILLY
    string
    default "STM32F4"

config CHIP
    string
    default "STM32F407xx"

config ARCH
    string
    default "cortex-m4"

config DUAL_CORE
    bool
    default n

config HAS_LOAD_MEMORY_RAM
    bool
    default n

config HAS_LOAD_MEMORY_FLASH
    bool
    default y

config HAS_FPU
    bool
    default y

config FPU_TYPE
    string
    default "fpv4-sp-d16"

config HAS_CACHE
    bool
    default n

config HAS_MPU
    bool
    default n

config HAS_WDG
    bool
    default y

config HAS_ECC
    bool
    default n

config HAS_FS_SPISD
    bool
    default y

config HAS_FS_SD
    bool
    default n

config HAS_FS_RAM
    bool
    default n

config HAS_QSPI_NAND
    bool
    default n

config HAS_INVERTED_SYSLED_LOGIC
    bool
    default n
```

## bsp/KLARA-BSP/Kconfig
```kconfig
config BOARD_NAME
    string
    default "KLARA"

config CHIP_VENDOR
    string
    default "ST"

config CHIP_FAMILLY
    string
    default "STM32H7"

config CHIP
    string
    default "STM32H753xx"

config ARCH
    string
    default "cortex-m7"

config DUAL_CORE
    bool
    default n

config HAS_LOAD_MEMORY_RAM
    bool
    default y

config HAS_LOAD_MEMORY_FLASH
    bool
    default y

config HAS_FPU
    bool
    default y

config FPU_TYPE
    string
    default "fpv5-d16"

config HAS_CACHE
    bool
    default y

config HAS_MPU
    bool
    default y

config HAS_WDG
    bool
    default y

config HAS_ECC
    bool
    default y

config HAS_SPISD_DISK
    bool
    default n

config HAS_SD_DISK
    bool
    default n

config HAS_RAM_DISK
    bool
    default n

config HAS_NAND_DISK
    bool
    default y

config HAS_QSPI_NOR_MEMORY
    bool
    default n

config HAS_USB_OTG
    bool
    default n

config HAS_INVERTED_SYSLED_LOGIC
    bool
    default y
```

## bsp/NUCLEO_F411RE-BSP/Kconfig
```kconfig
config BOARD_NAME
    string
    default "NUCLEO_F411RE"

config CHIP_VENDOR
    string
    default "ST"

config CHIP_FAMILLY
    string
    default "STM32F4"

config CHIP
    string
    default "STM32F411xE"

config ARCH
    string
    default "cortex-m4"

config DUAL_CORE
    bool
    default n

config HAS_LOAD_MEMORY_RAM
    bool
    default n

config HAS_LOAD_MEMORY_FLASH
    bool
    default y

config HAS_FPU
    bool
    default y

config FPU_TYPE
    string
    default "fpv4-sp-d16"

config HAS_CACHE
    bool
    default n

config HAS_MPU
    bool
    default n

config HAS_WDG
    bool
    default y

config HAS_ECC
    bool
    default n

config HAS_SPISD_MEMORY
    bool
    default y

config HAS_SD_MEMORY
    bool
    default n

config HAS_RAM_MEMORY
    bool
    default n

config HAS_FMC_NAND_MEMORY
    bool
    default n

config HAS_QSPI_NOR_MEMORY
    bool
    default n

config HAS_USB_OTG
    bool
    default n

config HAS_INVERTED_SYSLED_LOGIC
    bool
    default n
```

## bsp/NUCLEO_H745ZI-BSP/Kconfig
```kconfig
config BOARD_NAME
    string
    default "NUCLEO_H745ZI"

config CHIP_VENDOR
    string
    default "ST"

config CHIP_FAMILLY
    string
    default "STM32H7"

config CHIP
    string
    default "STM32H745xx"

config ARCH
    string
    default "cortex-m7"

config DUAL_CORE
    bool
    default y

config CORE_SELECT
    string
    default "CORE_CM7"

config HAS_LOAD_MEMORY_RAM
    bool
    default y

config HAS_LOAD_MEMORY_FLASH
    bool
    default y

config HAS_FPU
    bool
    default y

config FPU_TYPE
    string
    default "fpv5-d16"

config HAS_CACHE
    bool
    default y

config HAS_MPU
    bool
    default y

config HAS_WDG
    bool
    default y

config HAS_ECC
    bool
    default y

config HAS_SPISD_MEMORY
    bool
    default y

config HAS_SD_MEMORY
    bool
    default n

config HAS_RAM_MEMORY
    bool
    default n

config HAS_FMC_NAND_MEMORY
    bool
    default n

config HAS_QSPI_FLASH_MEMORY
    bool
    default n

config HAS_USB_OTG
    bool
    default n

config HAS_INVERTED_SYSLED_LOGIC
    bool
    default n
```

## gen/Kconfig
```kconfig
mainmenu "TAPAS Flight Software Configuration"

menu "General setup"

config CONFIG_NAME
    string "Configuration Name"
    default "default"
    help
        The name of the configuration that will be used when saving or loading configs.

config PROJ_NAME
    string "Project Name"
    default "flight-software"
    help
        Enter the project name for the flight software.

choice
    prompt "Target Board"
    default BOARD_ART_PI
    help
        Select the target board for the build.

config BOARD_ART_PI
    bool "ART PI"
config BOARD_KLARA
    bool "KLARA"
config BOARD_QEMU
    bool "QEMU"
config BOARD_NUCLEO_H745ZI
    bool "Nucleo H745ZI"
config BOARD_NUCLEO_F411RE
    bool "Nucleo F411RE"

endchoice

if BOARD_ART_PI
source "kernel/bsp/ART_PI-BSP/Kconfig"
endif

if BOARD_KLARA
source "kernel/bsp/KLARA-BSP/Kconfig"
endif

if BOARD_QEMU
source "kernel/bsp/QEMU-BSP/Kconfig"
endif

if BOARD_NUCLEO_H745ZI
source "kernel/bsp/NUCLEO_H745ZI-BSP/Kconfig"
endif

if BOARD_NUCLEO_F411RE
source "kernel/bsp/NUCLEO_F411RE-BSP/Kconfig"
endif

config IS_A_TEST
    bool "Enable Test Mode"
    help
        Enable this option to configure and select a specific test to run.

if IS_A_TEST
choice
    prompt "Select the Target Test"
    help
        Choose a specific test to run if Test Mode is enabled.

config TEST_HELLO
    bool "Hello Test"

config TEST_FDIR
    bool "FDIR Test"

config TEST_IRIDIUM
    bool "Iridium Test"

config TEST_OW
    bool "OneWire Test"

config TEST_I2C
    bool "I2C Test"

config TEST_TIMERS
    bool "Timers Test"

config TEST_USAGE
    bool "Usage Test"

endchoice

config TEST_NAME
    string
    help
        Automatically sets the test name based on the selected test.
    depends on IS_A_TEST
    default "test-hello" if TEST_HELLO
    default "test-fdir" if TEST_FDIR
    default "test-iridium" if TEST_IRIDIUM
    default "test-ow" if TEST_OW
    default "test-i2c" if TEST_I2C
    default "test-timers" if TEST_TIMERS
    default "test-usage" if TEST_USAGE
    default ""

endif

endmenu # General setup

menu "Build Configuration"

choice
    prompt "Optimization level"
    default OPT_O0
    help
      Select the compiler optimization level.

config OPT_O0
    bool "No optimization (-O0)"

config OPT_O1
    bool "Optimize (-O1)"

config OPT_O2
    bool "Optimize more (-O2)"

config OPT_O3
    bool "Optimize even more (-O3)"

config OPT_OS
    bool "Optimize for size (-Os)"

endchoice

choice
    prompt "Debug information level"
    default DEBUG_G3
    help
      Select the amount of debugging information generated by the compiler.

config DEBUG_G0
    bool "No debug info (-g0)"

config DEBUG_G1
    bool "Minimal debug info (-g1)"

config DEBUG_G2
    bool "Default debug info (-g2)"

config DEBUG_G3
    bool "Maximum debug info (-g3)"

endchoice

endmenu # Build Configuration

menu "Kernel Configuration"

config KERNEL_DEFCONFIG
    string "Kernel Configuration"
    default "default_defconfig"
    help
      Choose a kernel configuration.

endmenu # Kernel Configuration
```

## kernel/bsp/ART_PI-BSP/Kconfig
```kconfig
config BOARD_NAME
    string
    default "ART_PI"

config CHIP_VENDOR
    string
    default "ST"

config CHIP_FAMILLY
    string
    default "STM32H7"

config CHIP
    string
    default "STM32H750xx"

config ARCH
    string
    default "cortex-m7"

config LOAD_MEMORY_RAM
    bool
    default y

config HAS_FPU
    bool
    default y

config FPU_TYPE
    string
    default "fpv5-d16"

config HAS_CACHE
    bool
    default y

config HAS_MPU
    bool
    default y

config HAS_WDG
    bool
    default y

config HAS_ECC
    bool
    default y

config HAS_SD_MEMORY
    bool
    default y

config HAS_RAM_MEMORY
    bool
    default y

config HAS_QSPI_NOR_MEMORY
    bool
    default y

config HAS_INVERTED_SYSLED_LOGIC
    bool
    default y
```

## kernel/bsp/NUCLEO_F411RE-BSP/Kconfig
```kconfig
config BOARD_NAME
    string
    default "NUCLEO_F411RE"

config CHIP_VENDOR
    string
    default "ST"

config CHIP_FAMILLY
    string
    default "STM32F4"

config CHIP
    string
    default "STM32F411xE"

config ARCH
    string
    default "cortex-m4"

config LOAD_MEMORY_FLASH
    bool
    default y

config HAS_FPU
    bool
    default y

config FPU_TYPE
    string
    default "fpv4-sp-d16"

config HAS_WDG
    bool
    default y

config HAS_SPISD_MEMORY
    bool
    default y
```

## kernel/bsp/QEMU-BSP/Kconfig
```kconfig
config BOARD_NAME
    string
    default "QEMU"

config CHIP_VENDOR
    string
    default "ARM"

config CHIP_FAMILLY
    string
    default "CMSDK"

config CHIP
    string
    default "CMSDK_CM7"

config ARCH
    string
    default "cortex-m7"

config LOAD_MEMORY_RAM
    bool
    default y

config HAS_FPU
    bool
    default y

config FPU_TYPE
    string
    default "fpv5-d16"

config HAS_CACHE
    bool
    default y

config HAS_MPU
    bool
    default y

config HAS_RAM_MEMORY
    bool
    default y
```
